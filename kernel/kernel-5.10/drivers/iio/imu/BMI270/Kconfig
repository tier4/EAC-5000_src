## kernel/kernel-5.10/drivers/iio/imu/BMI270/Kconfig
```kconfig
#
# Makefile for Bosch sensors driver.
#
config BOSCH_DRIVER_LOG_FUNC
	tristate "Bosch Sensortec driver smart log function support"
	depends on (I2C || SPI_MASTER) && SYSFS
	help
	 If you say yes here, you get support for smart log function in Bosch Sensortec driver.
```

## kernel/kernel-5.10/drivers/stereolabs/Kconfig
```kconfig
if VIDEO_V4L2

menu "Stereolabs Drivers"
  source "drivers/stereolabs/max9296/Kconfig"
  source "drivers/stereolabs/max96712/Kconfig"
  source "drivers/stereolabs/zedx/Kconfig"
endmenu

endif
```

## kernel/kernel-5.10/drivers/stereolabs/max9296/Kconfig
```kconfig
config SL_DESER_MAX9296
	tristate "Stereolabs MAX9296 Deserializer"
	help
	  If you say yes here you get support for the MAX9296 deserializer.

	  To compile this driver as a module, choose M here: the module
	  will be called max9296.
```
